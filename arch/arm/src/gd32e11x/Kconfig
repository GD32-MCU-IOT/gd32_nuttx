## boards/arm/gd32f4/gd32f470ik-eval/Kconfig
```kconfig
#
# For a description of the syntax of this configuration file,
# see the file kconfig-language.txt in the NuttX tools repository.
#

if ARCH_BOARD_GD32F470IK_EVAL

choice
	prompt "Select Console wiring."
	default GD32F470IK_EVAL_CONSOLE_BOARD
	---help---
		Select where you will connect the console.

		Eval COM Port:

		BOARD USART Connector:

		Advantage: You have a shield so it is easy.

		Disadvantage: You loose the use of the
		other functions on PA9, PA10

				GD32F470IK_EVAL
			USART0 GPIO
			-- ----- --------- ----
			RX    USART0_RX PA10
			TX    USART0_TX PA9
			-- ----- --------- ---

config GD32F470IK_EVAL_CONSOLE_BOARD
	bool "Eval Com Connector"
	select GD32_USART0
	select USART0_SERIALDRIVER

config GD32F470IK_EVAL_CONSOLE_VIRTUAL
	bool "Virtual ComPort"
	select GD32_USART3
	select USART3_SERIALDRIVER

config GD32F470IK_EVAL_CONSOLE_NONE
	bool "No Serial Console"

endchoice # "Select Console wiring"


choice
	prompt "GD32F470I MCU Crystal Selected"
	default GD32F470I_BOARD_USE_HXTAL

config GD32F470I_BOARD_USE_HXTAL
	bool "Use Hxtal as clock source"
	# select GD32F470I_BOARD_HXTAL_VALUE

config GD32F470I_BOARD_USE_IRC16
	bool "Use IRC16M as clock source"

endchoice # CPU Frequency

config GD32F470I_BOARD_HXTAL_VALUE
	int "GD32F470I Eval Board Hxtal Value"
	default 25000000
	depends on GD32F470I_BOARD_USE_HXTAL
	---help---
		GD32F470I Eval Board Hxtal Value, default is 25MHz.

choice
	prompt "GD32F470 MCU System Frequency"
	default GD32F470I_200MHZ

config GD32F470I_240MHZ
	bool "240 MHz"
	
config GD32F470I_200MHZ
	bool "200 MHz"

config GD32F470I_168MHZ
	bool "168 MHz"

config GD32F470I_120MHZ
	bool "120 MHz"

endchoice # CPU Frequency


config GD32F470IK_EVAL_GD25_BLOCKMOUNT
	bool "GD25 serial FLASH auto-mount"
	default n
	depends on GD32F4_SPI5 && MTD_GD25
	---help---
		Automatically initialize the GD25 SPI FLASH driver when NSH starts.

choice
	prompt "GD25 SPI FLASH configuration"
	default GD32F470IK_EVAL_GD25_NXFFS
	depends on GD32F470IK_EVAL_GD25_BLOCKMOUNT

config GD32F470IK_EVAL_GD25_FTL
	bool "Create GD25 SPI FLASH block driver"
	---help---
		Create the MTD driver for the GD25 and "wrap" the GD25 as a standard
		block driver that could then, for example, be mounted using FAT or
		any other file system. Any file system may be used, but there will
		be no wear-leveling.

config GD32F470IK_EVAL_GD25_NXFFS
	bool "Create GD25 serial FLASH NXFFS file system"
	depends on FS_NXFFS
	---help---
		Create the MTD driver for the GD25 and mount the GD25 device as
		a wear-leveling, NuttX FLASH file system (NXFFS).  The downside of
		NXFFS is that it can be very slow.

config GD32F470IK_EVAL_GD25_LITTLEFS
	bool "Create GD25 serial FLASH LFS file system"
	depends on FS_LITTLEFS
	---help---
		Create the MTD driver for the GD25 and mount the GD25 device as
		a wear-leveling, LittleFS FLASH file system (LFS).

endchoice # GD25 serial FLASH configuration

config GD32F470IK_EVAL_AT24_TEST
	bool "I2C0 EEPROM AT2402 write and read test"
	default n
	depends on NSH_ARCHINIT && GD32F4_I2C0 && MTD_AT24XX
	---help---
		Automatically initialize and test the AT24 I2C EEPROM driver when
		NSH starts. After test the I2C0 will be released.

config AT24XX_MTD_BLOCKSIZE
	int "AT24xx MTD block size"
	default 8
	depends on GD32F470IK_EVAL_AT24_TEST
	---help---
		The block size must be an even multiple of the pages.
		The page size of AT2402 on the board is 8 Byte.

config GD32F4_CAMPREVIEW
	bool "Board-level camera preview (OV2640 → LCD centre)"
	default n
	depends on GD32F4_DCI && VIDEO_FB
	---help---
		Start a kernel thread that continuously captures 320x240 RGB565
		frames from the OV2640 via /dev/video0 and blits them centred on
		the 480x272 TLI framebuffer (/dev/fb0).

		The image is placed at pixel offset (80, 16) so that it appears
		in the middle of the LCD.  This avoids the NX graphics server and
		fixes the 6-split artefact caused by mismatched source/destination
		strides in the upstream camera example.

		Requires CONFIG_GD32F4_DCI and CONFIG_VIDEO_FB to be enabled.

if GD32F4_CAMPREVIEW

config GD32F4_CAMPREVIEW_PRIORITY
	int "Camera preview thread priority"
	default 100
	---help---
		Scheduling priority of the campreview kernel thread.

config GD32F4_CAMPREVIEW_STACKSIZE
	int "Camera preview thread stack size (bytes)"
	default 4096
	---help---
		Stack size for the campreview kernel thread.

config GD32F4_CAMPREVIEW_DURATION
	int "Camera preview run duration (seconds, 0=forever)"
	default 10
	---help---
		How many seconds the camera preview thread will stream video
		to the LCD before stopping and clearing the screen.
		Set to 0 to run indefinitely.

endif # GD32F4_CAMPREVIEW

endif # ARCH_BOARD_GD32F470IK_EVAL
```

## boards/arm/gd32h7xx/gd32h759im-eval/Kconfig
```kconfig
#
# For a description of the syntax of this configuration file,
# see the file kconfig-language.txt in the NuttX tools repository.
#

if ARCH_BOARD_GD32H759IM_EVAL

choice
	prompt "Select Console wiring."
	default GD32H759IM_EVAL_CONSOLE_BOARD
	---help---
		Select where you will connect the console.

		Eval COM Port:

		BOARD USART Connector:

		Advantage: You have a shield so it is easy.

		Disadvantage: You loose the use of the
		other functions on PA9, PA10

				GD32H759IM_EVAL
			USART0 GPIO
			-- ----- --------- ----
			RX    USART0_RX PA10
			TX    USART0_TX PA9
			-- ----- --------- ---

config GD32H759IM_EVAL_CONSOLE_BOARD
	bool "Eval Com Connector"
	select GD32H7_USART0
	select USART0_SERIALDRIVER

config GD32H759IM_EVAL_CONSOLE_VIRTUAL
	bool "USART2 Console"
	select GD32H7_USART2
	select USART2_SERIALDRIVER

config GD32H759IM_EVAL_CONSOLE_NONE
	bool "No Serial Console"

endchoice # "Select Console wiring"

choice
	prompt "GD32H759I MCU Crystal Selected"
	default GD32H759I_BOARD_USE_HXTAL

config GD32H759I_BOARD_USE_HXTAL
	bool "Use HXTAL as clock source"

config GD32H759I_BOARD_USE_IRC64M
	bool "Use IRC64M as clock source"

endchoice # "MCU Crystal Selected"

config GD32H759I_BOARD_HXTAL_VALUE
	int "GD32H759I Eval Board HXTAL Value"
	default 25000000
	depends on GD32H759I_BOARD_USE_HXTAL
	---help---
		GD32H759I Eval Board HXTAL Value, default is 25MHz.

choice
	prompt "GD32H759 MCU System Frequency"
	default GD32H759I_600MHZ

config GD32H759I_600MHZ
	bool "600 MHz"

config GD32H759I_480MHZ
	bool "480 MHz"

config GD32H759I_400MHZ
	bool "400 MHz"

endchoice # "MCU System Frequency"

config ARCH_BOARD_GD32H7XX_CUSTOM_CLOCKCONFIG
	bool "Enable board-specific clock configuration"
	default n
	---help---
		Enables board-specific clock configuration in board/src.

menu "GD32H759IM-EVAL GD25 Flash Configuration"
	depends on MTD_GD25

config GD32H759IM_EVAL_GD25_BLOCKMOUNT
	bool "Enable GD25 block device mount"
	default n
	---help---
		Enable mounting of GD25 flash as a block device

if GD32H759IM_EVAL_GD25_BLOCKMOUNT

choice
	prompt "GD25 file system type"
	default GD32H759IM_EVAL_GD25_LITTLEFS

config GD32H759IM_EVAL_GD25_FTL
	bool "FTL"

config GD32H759IM_EVAL_GD25_NXFFS
	bool "NXFFS"
	depends on FS_NXFFS

config GD32H759IM_EVAL_GD25_LITTLEFS
	bool "LittleFS"
	depends on FS_LITTLEFS

endchoice

endif # GD32H759IM_EVAL_GD25_BLOCKMOUNT

endmenu # GD25 Flash Configuration

endif
```
